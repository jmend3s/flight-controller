## CMakeLists.txt
```
target_include_directories(app PRIVATE
     ${CMAKE_CURRENT_SOURCE_DIR}/src/modules
     ${CMAKE_CURRENT_SOURCE_DIR}/src/services
)

add_subdirectory(src)
```

## prj.conf
```kconfig
# =======================
# Basic system setup
# =======================
CONFIG_MAIN_STACK_SIZE=2048
CONFIG_PRINTK=y
CONFIG_UART_CONSOLE=n

# =======================
# Drivers
# =======================
CONFIG_SPI=y
CONFIG_I2C=y
CONFIG_PWM=y
CONFIG_ADC=y
CONFIG_GPIO=y

# =======================
# Logging
# =======================
CONFIG_LOG_DEFAULT_LEVEL=1

# =======================
# Threads / analysis
# =======================
CONFIG_THREAD_ANALYZER=n
CONFIG_THREAD_MONITOR=n

# =======================
# C++ Support
# =======================
CONFIG_CPP=y
CONFIG_STD_CPP17=y
CONFIG_MINIMAL_LIBC=y
CONFIG_NEWLIB_LIBC=n
CONFIG_HEAP_MEM_POOL_SIZE=16384

CONFIG_USB_DEVICE_STACK=y

# Enable the CDC ACM class (Serial Port)

CONFIG_STDOUT_CONSOLE=y
CONFIG_USB_DEVICE_STACK=y
CONFIG_USB_DEVICE_PRODUCT="Zephyr CDC ACM sample"
CONFIG_USB_DEVICE_PID=0x0001
CONFIG_LOG=y
CONFIG_USB_DRIVER_LOG_LEVEL_ERR=y
CONFIG_USB_DEVICE_LOG_LEVEL_ERR=y
CONFIG_SERIAL=y
CONFIG_UART_INTERRUPT_DRIVEN=n
CONFIG_UART_LINE_CTRL=y
CONFIG_USB_DEVICE_INITIALIZE_AT_BOOT=y
```

## src/main.cpp
```c
#include "../../corekit/runtime/System.h"
#include "../../corekit/time/TimeSource.h"
#include "Gpio.h"

#include "application/Application.h"

#include <zephyr/kernel.h>
#include <zephyr/drivers/adc.h>
#include <zephyr/drivers/gpio.h>
#include <zephyr/drivers/i2c.h>
#include <zephyr/drivers/pwm.h>

static constexpr gpio_dt_spec redLedDt = GPIO_DT_SPEC_GET(DT_ALIAS(redled), gpios);
static  GpioSpec redLedSpec(reinterpret_cast<uintptr_t>(&redLedDt));

static constexpr gpio_dt_spec yellowLedDt = GPIO_DT_SPEC_GET(DT_ALIAS(yellowled), gpios);
static  GpioSpec yellowLedSpec(reinterpret_cast<uintptr_t>(&yellowLedDt));

static constexpr gpio_dt_spec greenLedDt = GPIO_DT_SPEC_GET(DT_ALIAS(greenled), gpios);
static  GpioSpec greenLedSpec(reinterpret_cast<uintptr_t>(&greenLedDt));

static constexpr adc_dt_spec adcChannel = ADC_DT_SPEC_GET(DT_PATH(zephyr_user));
static AdcSpec adcSpec(reinterpret_cast<uintptr_t>(&adcChannel));

static constexpr i2c_dt_spec mpu = I2C_DT_SPEC_GET(DT_ALIAS(mpu6050));
static I2cSpec imuSpec(reinterpret_cast<uintptr_t>(&mpu));

static constexpr pwm_dt_spec pwmLedSpec = PWM_DT_SPEC_GET(DT_ALIAS(pwm_led0));
static PwmSpec ledSpec(reinterpret_cast<uintptr_t>(&pwmLedSpec));

int main()
{
    Application app(adcSpec, greenLedSpec, yellowLedSpec, redLedSpec, imuSpec, ledSpec);
    System system(app.components(), app.storage(), app.count(), app.time());

    system.run();
}
```
