## zephyr_ws/boards/arm/teensy41/kconfig.board
```kconfig
config BOARD_TEENSY41
    bool "Teensy 4.1"
    depends on SOC_MIMXRT1062
    help
      Enable support for the PJRC Teensy 4.1 development board.
```

## zephyr_ws/boards/arm/teensy41/teensy41_defconfig
```kconfig
CONFIG_SOC_MIMXRT1062=y
CONFIG_BOARD="teensy41"
CONFIG_CLOCK_CONTROL=y
CONFIG_GPIO=y
CONFIG_SERIAL=y
CONFIG_CONSOLE=y
CONFIG_UART_CONSOLE=y
CONFIG_SYS_CLOCK_HW_CYCLES_PER_SEC=600000000
```
