## CMakeLists.txt
```
cmake_minimum_required(VERSION 3.20.0)
find_package(Zephyr REQUIRED HINTS $ENV{ZEPHYR_BASE})
project(flight_controller)

zephyr_include_directories(
  ${CMAKE_CURRENT_SOURCE_DIR}/../../drivers
#  ${CMAKE_CURRENT_SOURCE_DIR}/../../services
)

file(GLOB_RECURSE DRIVER_SOURCES ${CMAKE_CURRENT_SOURCE_DIR}/../../drivers/*.cpp)
target_sources(app PRIVATE
  src/main.cpp
  ${DRIVER_SOURCES}
)
```

## prj.conf
```kconfig
# Basic system config
CONFIG_MAIN_STACK_SIZE=2048
CONFIG_HEAP_MEM_POOL_SIZE=8192
CONFIG_PRINTK=y
CONFIG_SERIAL=y
CONFIG_UART_CONSOLE=y

# Enable drivers
CONFIG_SPI=y
CONFIG_I2C=y
CONFIG_PWM=y
CONFIG_ADC=y
CONFIG_GPIO=y

# Logging
CONFIG_LOG=y
CONFIG_LOG_DEFAULT_LEVEL=3

# Threading
CONFIG_THREAD_ANALYZER=y
CONFIG_THREAD_MONITOR=y

# Enable C++
CONFIG_CPP=y
CONFIG_MINIMAL_LIBC=y
CONFIG_HEAP_MEM_POOL_SIZE=8192
```

## src/main.cpp
```c
#include <zephyr/kernel.h>
#include <zephyr/sys/printk.h>

class FlightController {
public:
    FlightController() { printk("Constructor called!\n"); }
    void loop() { printk("Loop tick\n"); }
};

extern "C" int main(void)
{
    printk("Booting...\n");
    FlightController fc;
    while (true) {
        fc.loop();
        k_msleep(1000);
    }
}
```
